/**
 * @cliArgs --board "/ti/boards/CC3235S_LAUNCHXL" --product "simplelink_cc32xx_sdk@5.20.00.06"
 * @versions {"data":"2021031521","timestamp":"2021031521","tool":"1.8.0+1863","templates":null}
 */

/**
 * Import the modules used in this configuration.
 */
const DriverLib      = scripting.addModule("/ti/devices/DriverLib");
const Display        = scripting.addModule("/ti/display/Display");
const Display1       = Display.addInstance();
const Board          = scripting.addModule("/ti/drivers/Board");
const Crypto         = scripting.addModule("/ti/drivers/Crypto");
const Crypto1        = Crypto.addInstance();
const DMA            = scripting.addModule("/ti/drivers/DMA");
const GPIO           = scripting.addModule("/ti/drivers/GPIO", {}, false);
const GPIO1          = GPIO.addInstance();
const I2C            = scripting.addModule("/ti/drivers/I2C", {}, false);
const I2C1           = I2C.addInstance();
const Power          = scripting.addModule("/ti/drivers/Power");
const RTOS           = scripting.addModule("/ti/drivers/RTOS");
const SPI            = scripting.addModule("/ti/drivers/SPI");
const SPI1           = SPI.addInstance();
const Timer          = scripting.addModule("/ti/drivers/Timer");
const Timer1         = Timer.addInstance();
const Timer2         = Timer.addInstance();
const Timer3         = Timer.addInstance();
const Watchdog       = scripting.addModule("/ti/drivers/Watchdog");
const Watchdog1      = Watchdog.addInstance();
const SimpleLinkWifi = scripting.addModule("/ti/drivers/net/wifi/SimpleLinkWifi");
const atcmd          = scripting.addModule("/ti/drivers/net/wifi/atcmd", {}, false);
const atcmd1         = atcmd.addInstance();
const net_utils      = scripting.addModule("/ti/drivers/net/wifi/net_utils", {}, false);
const net_utils1     = net_utils.addInstance();
const HTTPClient     = scripting.addModule("/ti/net/HTTPClient", {}, false);
const HTTPClient1    = HTTPClient.addInstance();
const MQTT           = scripting.addModule("/ti/net/MQTT", {}, false);
const MQTT1          = MQTT.addInstance();
const SNTP           = scripting.addModule("/ti/net/SNTP");
const SlNet          = scripting.addModule("/ti/net/SlNet");
const SlNet1         = SlNet.addInstance();
const JSON           = scripting.addModule("/ti/utils/JSON");

/**
 * Write custom configuration values to the imported modules.
 */
Display1.$name                          = "CONFIG_Display_0";
Display1.$hardware                      = system.deviceData.board.components.XDS110UART;
Display1.uart.$name                     = "CONFIG_UART_0";
Display1.uart.useDMA                    = true;
Display1.uart.uart.$assign              = "UART0";
Display1.uart.uart.txPin.$assign        = "55";
Display1.uart.uart.rxPin.$assign        = "57";
Display1.uart.uart.txDmaChannel.$assign = "UDMA_CH9";
Display1.uart.uart.rxDmaChannel.$assign = "UDMA_CH8";

Crypto1.$name = "CONFIG_Crypto_0";

GPIO1.$name              = "CAM_SPI_SS";
GPIO1.mode               = "Output";
GPIO1.pull               = "Pull Up";
GPIO1.initialOutputState = "High";
GPIO1.gpioPin.$assign    = "boosterpack.18";

I2C1.$name     = "CONFIG_I2C_0";
I2C1.$hardware = system.deviceData.board.components.LP_I2C;

Power.ioRetentionShutdown = ["GRP_1"];
Power.parkPins.$name      = "ti_drivers_power_PowerCC32XXPins0";

SPI1.$name                    = "CONFIG_SPI_0";
SPI1.defaultTxBufferValue     = "0";
SPI1.ssControl                = "SW";
SPI1.turboMode                = true;
SPI1.spi.$assign              = "SPI0";
SPI1.spi.sclkPin.$assign      = "boosterpack.7";
SPI1.spi.misoPin.$assign      = "boosterpack.14";
SPI1.spi.mosiPin.$assign      = "boosterpack.15";
SPI1.spi.dmaRxChannel.$assign = "UDMA_CH6";
SPI1.spi.dmaTxChannel.$assign = "UDMA_CH7";

Timer1.$name         = "CONFIG_TIMER_0";
Timer1.timerType     = "32 Bits";
Timer1.timer.$assign = "Timer0";

Timer2.$name         = "CONFIG_TIMER_1";
Timer2.timer.$assign = "Timer1";

Timer3.$name         = "CONFIG_TIMER_2";
Timer3.timer.$assign = "Timer1";

Watchdog1.$name            = "CONFIG_WATCHDOG_0";
Watchdog1.watchdog.$assign = "WATCHDOG0";

atcmd1.$name = "CONFIG_ATCMD_0";

net_utils1.$name = "CONFIG_NET_UTILS_0";

HTTPClient1.$name = "CONFIG_HTTPCLIENT_0";

MQTT1.$name = "CONFIG_MQTT_0";

SlNet1.$name  = "CONFIG_SLNET";
SlNet1.ifName = "CC32xx";

/**
 * Pinmux solution for unlocked pins/peripherals. This ensures that minor changes to the automatic solver in a future
 * version of the tool will not impact the pinmux you originally saw.  These lines can be completely deleted in order to
 * re-solve from scratch.
 */
I2C1.i2c.$suggestSolution        = "I2C0";
I2C1.i2c.sdaPin.$suggestSolution = "boosterpack.10";
I2C1.i2c.sclPin.$suggestSolution = "boosterpack.9";
