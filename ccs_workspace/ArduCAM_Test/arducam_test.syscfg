/**
 * @cliArgs --board "/ti/boards/CC3235S_LAUNCHXL" --product "simplelink_cc32xx_sdk@5.20.00.06"
 * @versions {"data":"2021031521","timestamp":"2021031521","tool":"1.8.0+1863","templates":null}
 */
const bp_BPBASSENSORSMKII = scripting.addHardware("/ti/boards/boosterpacks/BP-BASSENSORSMKII");

/**
 * Import the modules used in this configuration.
 */
const Display  = scripting.addModule("/ti/display/Display");
const Display1 = Display.addInstance();
const GPIO     = scripting.addModule("/ti/drivers/GPIO", {}, false);
const GPIO1    = GPIO.addInstance();
const I2C      = scripting.addModule("/ti/drivers/I2C");
const I2C1     = I2C.addInstance();
const RTOS     = scripting.addModule("/ti/drivers/RTOS");
const SPI      = scripting.addModule("/ti/drivers/SPI");
const SPI1     = SPI.addInstance();

/**
 * Write custom configuration values to the imported modules.
 */
Display1.$name      = "CONFIG_Display_0";
Display1.$hardware  = system.deviceData.board.components.XDS110UART;
Display1.uart.$name = "CONFIG_UART_0";

GPIO1.pull               = "Pull Up";
GPIO1.$name              = "CAM_SPI_SS";
GPIO1.mode               = "Output";
GPIO1.initialOutputState = "High";
GPIO1.gpioPin.$assign    = "boosterpack.18";

I2C1.$name     = "CONFIG_I2C_0";
I2C1.$hardware = system.deviceData.board.components.LP_I2C;

const Power          = scripting.addModule("/ti/drivers/Power", {}, false);
Power.parkPins.$name = "ti_drivers_power_PowerCC32XXPins0";

SPI1.$name       = "CONFIG_SPI_0";
SPI1.ssControl   = "SW";
SPI1.turboMode   = true;
SPI1.spi.$assign = "SPI0";

/**
 * Pinmux solution for unlocked pins/peripherals. This ensures that minor changes to the automatic solver in a future
 * version of the tool will not impact the pinmux you originally saw.  These lines can be completely deleted in order to
 * re-solve from scratch.
 */
Display1.uart.uart.$suggestSolution       = "UART1";
Display1.uart.uart.txPin.$suggestSolution = "55";
Display1.uart.uart.rxPin.$suggestSolution = "57";
I2C1.i2c.$suggestSolution                 = "I2C0";
I2C1.i2c.sdaPin.$suggestSolution          = "boosterpack.10";
I2C1.i2c.sclPin.$suggestSolution          = "boosterpack.9";
SPI1.spi.sclkPin.$suggestSolution         = "boosterpack.7";
SPI1.spi.misoPin.$suggestSolution         = "boosterpack.14";
SPI1.spi.mosiPin.$suggestSolution         = "boosterpack.15";
SPI1.spi.dmaRxChannel.$suggestSolution    = "UDMA_CH30";
SPI1.spi.dmaTxChannel.$suggestSolution    = "UDMA_CH31";
