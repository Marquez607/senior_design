/**
 * @cliArgs --board "/ti/boards/CC3235S_LAUNCHXL" --product "simplelink_cc32xx_sdk@5.20.00.06"
 * @versions {"data":"2021031521","timestamp":"2021031521","tool":"1.8.0+1863","templates":null}
 */

/**
 * Import the modules used in this configuration.
 */
const GPIO   = scripting.addModule("/ti/drivers/GPIO");
const GPIO1  = GPIO.addInstance();
const RTOS   = scripting.addModule("/ti/drivers/RTOS");
const UART   = scripting.addModule("/ti/drivers/UART");
const UART1  = UART.addInstance();
const UART2  = scripting.addModule("/ti/drivers/UART2", {}, false);
const UART21 = UART2.addInstance();

/**
 * Write custom configuration values to the imported modules.
 */
GPIO1.$hardware = system.deviceData.board.components.LED_BLUE;
GPIO1.$name     = "CONFIG_GPIO_LED_0";

const Power          = scripting.addModule("/ti/drivers/Power", {}, false);
Power.parkPins.$name = "ti_drivers_power_PowerCC32XXPins0";

UART1.$name     = "CONFIG_UART_0";
UART1.$hardware = system.deviceData.board.components.XDS110UART;

UART21.$name              = "CONFIG_UART2_0";
UART21.uart.txPin.$assign = "boosterpack.4";
UART21.uart.rxPin.$assign = "boosterpack.3";
scripting.suppress("Connected to hardware,@@@.+?@@@ is connected to BMA280 Interrupt 1 on the CC3235S LaunchPad\. Consider selecting it in 'use hardware' above\. @@@.+?@@@",UART21.uart.rxPin);

/**
 * Pinmux solution for unlocked pins/peripherals. This ensures that minor changes to the automatic solver in a future
 * version of the tool will not impact the pinmux you originally saw.  These lines can be completely deleted in order to
 * re-solve from scratch.
 */
GPIO1.gpioPin.$suggestSolution            = "boosterpack.29";
UART1.uart.$suggestSolution               = "UART1";
UART1.uart.txPin.$suggestSolution         = "55";
UART1.uart.rxPin.$suggestSolution         = "57";
UART21.uart.$suggestSolution              = "UART0";
UART21.uart.txDmaChannel.$suggestSolution = "UDMA_CH9";
UART21.uart.rxDmaChannel.$suggestSolution = "UDMA_CH8";
