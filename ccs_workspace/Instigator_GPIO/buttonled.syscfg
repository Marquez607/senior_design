/**
 * @cliArgs --board "/ti/boards/CC3235S_LAUNCHXL" --product "simplelink_cc32xx_sdk@5.20.00.06"
 * @versions {"data":"2021031521","timestamp":"2021031521","tool":"1.8.0+1863","templates":null}
 */

/**
 * Import the modules used in this configuration.
 */
const Display  = scripting.addModule("/ti/display/Display");
const Display1 = Display.addInstance();
const GPIO     = scripting.addModule("/ti/drivers/GPIO", {}, false);
const GPIO1    = GPIO.addInstance();
const GPIO2    = GPIO.addInstance();
const GPIO3    = GPIO.addInstance();
const GPIO4    = GPIO.addInstance();
const GPIO5    = GPIO.addInstance();
const GPIO6    = GPIO.addInstance();
const GPIO7    = GPIO.addInstance();
const GPIO8    = GPIO.addInstance();
const GPIO9    = GPIO.addInstance();
const RTOS     = scripting.addModule("/ti/drivers/RTOS");

/**
 * Write custom configuration values to the imported modules.
 */
Display1.$name      = "CONFIG_Display_0";
Display1.$hardware  = system.deviceData.board.components.XDS110UART;
Display1.uart.$name = "CONFIG_UART_0";

GPIO1.mode            = "Output";
GPIO1.$name           = "SPEAKER_ENABLE";
GPIO1.outputStrength  = "High";
GPIO1.gpioPin.$assign = "boosterpack.19";

GPIO2.mode            = "Output";
GPIO2.$name           = "ULTRA_TRIG0";
GPIO2.gpioPin.$assign = "boosterpack.13";

GPIO3.$name           = "ULTRA_TRIG1";
GPIO3.mode            = "Output";
GPIO3.gpioPin.$assign = "boosterpack.27";

GPIO4.$name           = "ULTRA_ECHO1";
GPIO4.gpioPin.$assign = "boosterpack.28";

GPIO5.$name           = "ULTRA_TRIG2";
GPIO5.mode            = "Output";
GPIO5.gpioPin.$assign = "boosterpack.29";
scripting.suppress("Connected to hardware,@@@.+?@@@ is connected to LaunchPad Blue LED on the CC3235S LaunchPad\. Consider selecting it in 'use hardware' above\. @@@.+?@@@",GPIO5.gpioPin);

GPIO6.$name           = "ULTRA_ECHO2";
GPIO6.gpioPin.$assign = "boosterpack.30";

GPIO7.mode            = "Output";
GPIO7.$name           = "CAM_CS";
GPIO7.gpioPin.$assign = "boosterpack.18";

GPIO8.$name           = "ULTRA_ECHO_0_ALT";
GPIO8.gpioPin.$assign = "boosterpack.5";

GPIO9.mode            = "Output";
GPIO9.$name           = "ULTRA_TRIG_0_ALT";
GPIO9.gpioPin.$assign = "boosterpack.8";

const Power          = scripting.addModule("/ti/drivers/Power", {}, false);
Power.parkPins.$name = "ti_drivers_power_PowerCC32XXPins0";

/**
 * Pinmux solution for unlocked pins/peripherals. This ensures that minor changes to the automatic solver in a future
 * version of the tool will not impact the pinmux you originally saw.  These lines can be completely deleted in order to
 * re-solve from scratch.
 */
Display1.uart.uart.$suggestSolution       = "UART1";
Display1.uart.uart.txPin.$suggestSolution = "55";
Display1.uart.uart.rxPin.$suggestSolution = "57";
